## conf/distro/maria-distro.conf
```bitbake
require conf/distro/poky.conf

DISTRO = "maria-distro"
DISTRO_NAME = "Marie Linux"
DISTRO_VERSION = "1.0.0"
DISTRO_CODENAME = "scarthgap"

# Override these in poky-based distros
POKY_DEFAULT_DISTRO_FEATURES = ""
POKY_DEFAULT_EXTRA_RDEPENDS = "packagegroup-core-boot"
POKY_DEFAULT_EXTRA_RRECOMMENDS = ""

DISTRO_FEATURES:append = " polkit"

INIT_MANAGER = "systemd"
```

## conf/layer.conf
```bitbake
# We have a conf and classes directory, add to BBPATH
BBPATH .= ":${LAYERDIR}"

# We have recipes-* directories, add to BBFILES
BBFILES += "${LAYERDIR}/recipes-*/*/*.bb \
            ${LAYERDIR}/recipes-*/*/*.bbappend"

BBFILE_COLLECTIONS += "meta-marialinux"
BBFILE_PATTERN_meta-marialinux = "^${LAYERDIR}/"
BBFILE_PRIORITY_meta-marialinux = "6"

LAYERDEPENDS_meta-marialinux = "core"
LAYERSERIES_COMPAT_meta-marialinux = "scarthgap"
```
